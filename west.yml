## west.yml
```yaml
manifest:

  projects:
    - name: zephyr
      url: https://github.com/zephyrproject-rtos/zephyr
      revision: main
      path: zephyr
      west-commands: scripts/west-commands.yml
      import:
        name-allowlist:
          - cmsis

    - name: module-sample
      url: https://github.com/yashi/module-sample
      revision: main
      path: modules/lib/sample

  self:
    path: module-app
```
